## boards/shields/gabboard/Kconfig.defconfig
```kconfig
if SHIELD_GABBOARD_LEFT

config ZMK_KEYBOARD_NAME
    default "Gabboard Left"

config ZMK_SPLIT_BLE_ROLE_CENTRAL
    default y

endif

if SHIELD_GABBOARD_RIGHT

config ZMK_KEYBOARD_NAME
    default "Gabboard Right"

endif

if SHIELD_GABBOARD_LEFT || SHIELD_GABBOARD_RIGHT

config ZMK_SPLIT
    default y

endif
```

## boards/shields/gabboard/Kconfig.shield
```kconfig
# Copyright (c) 2021 The ZMK Contributors
# SPDX-License-Identifier: MIT

config SHIELD_GABBOARD_LEFT
    def_bool $(shields_list_contains,gabboard_left)
config SHIELD_GABBOARD_RIGHT
    def_bool $(shields_list_contains,gabboard_right)
```
